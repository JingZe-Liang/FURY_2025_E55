/******************************************************************************
* ASAP2 file: E55_1030.a2l
* Academic License - for use in teaching, academic research, and meeting
* course requirements at degree granting institutions only. Not for
* government, commercial, or other organizational use.
* Code generation for model "E55_1030".
* Model version : 1.759
* Simulink Coder version : 9.2 (R2019b) 18-Jul-2019
* C source code generated on : Sat Dec 13 14:30:39 2025
* Target selection: ec311.tlc
* Embedded hardware selection: ARM Compatible->ARM Cortex
* Code generation objectives: Unspecified
* Validation result: Not run
* (add additional file header information here)
******************************************************************************/ ASAP2_VERSION 1 31
/* Version 1.31 */
/begin PROJECT ECUCoderProject "ECUCoder Project"
/begin HEADER "Header Comments go here" /end HEADER
/begin MODULE ModuleName "Module Comment Goes Here"
/begin MOD_PAR "MOD PAR Comment Goes Here" /end MOD_PAR
/begin MOD_COMMON "Mod Common Comment Here" BYTE_ORDER MSB_LAST /end MOD_COMMON
/begin RECORD_LAYOUT Scalar_BOOLEAN FNC_VALUES 1 UBYTE COLUMN_DIR DIRECT /end RECORD_LAYOUT
/begin RECORD_LAYOUT Scalar_UBYTE FNC_VALUES 1 UBYTE COLUMN_DIR DIRECT /end RECORD_LAYOUT
/begin RECORD_LAYOUT Scalar_BYTE FNC_VALUES 1 SBYTE COLUMN_DIR DIRECT /end RECORD_LAYOUT
/begin RECORD_LAYOUT Scalar_UWORD FNC_VALUES 1 UWORD COLUMN_DIR DIRECT /end RECORD_LAYOUT
/begin RECORD_LAYOUT Scalar_SWORD FNC_VALUES 1 SWORD COLUMN_DIR DIRECT /end RECORD_LAYOUT
/begin RECORD_LAYOUT Scalar_ULONG FNC_VALUES 1 ULONG COLUMN_DIR DIRECT /end RECORD_LAYOUT
/begin RECORD_LAYOUT Scalar_LONG FNC_VALUES 1 SLONG COLUMN_DIR DIRECT /end RECORD_LAYOUT
/begin RECORD_LAYOUT Scalar_FLOAT32_IEEE FNC_VALUES 1 FLOAT32_IEEE COLUMN_DIR DIRECT /end RECORD_LAYOUT
/begin RECORD_LAYOUT Scalar_FLOAT64_IEEE FNC_VALUES 1 FLOAT64_IEEE COLUMN_DIR DIRECT /end RECORD_LAYOUT
/begin RECORD_LAYOUT Lookup1D_BOOLEAN FNC_VALUES 1 UBYTE COLUMN_DIR DIRECT /end RECORD_LAYOUT
/begin RECORD_LAYOUT Lookup1D_X_BOOLEAN AXIS_PTS_X 1 UBYTE INDEX_INCR DIRECT /end RECORD_LAYOUT
/begin RECORD_LAYOUT Lookup1D_BYTE FNC_VALUES 1 SBYTE COLUMN_DIR DIRECT /end RECORD_LAYOUT
/begin RECORD_LAYOUT Lookup1D_X_BYTE AXIS_PTS_X 1 SBYTE INDEX_INCR DIRECT /end RECORD_LAYOUT
/begin RECORD_LAYOUT Lookup1D_UBYTE FNC_VALUES 1 UBYTE COLUMN_DIR DIRECT /end RECORD_LAYOUT
/begin RECORD_LAYOUT Lookup1D_X_UBYTE AXIS_PTS_X 1 UBYTE INDEX_INCR DIRECT /end RECORD_LAYOUT
/begin RECORD_LAYOUT Lookup1D_UWORD FNC_VALUES 1 UWORD COLUMN_DIR DIRECT /end RECORD_LAYOUT
/begin RECORD_LAYOUT Lookup1D_X_UWORD AXIS_PTS_X 1 UWORD INDEX_INCR DIRECT /end RECORD_LAYOUT
/begin RECORD_LAYOUT Lookup1D_WORD FNC_VALUES 1 SWORD COLUMN_DIR DIRECT /end RECORD_LAYOUT
/begin RECORD_LAYOUT Lookup1D_X_WORD AXIS_PTS_X 1 SWORD INDEX_INCR DIRECT /end RECORD_LAYOUT
/begin RECORD_LAYOUT Lookup1D_ULONG FNC_VALUES 1 ULONG COLUMN_DIR DIRECT /end RECORD_LAYOUT
/begin RECORD_LAYOUT Lookup1D_X_ULONG AXIS_PTS_X 1 ULONG INDEX_INCR DIRECT /end RECORD_LAYOUT
/begin RECORD_LAYOUT Lookup1D_SLONG FNC_VALUES 1 SLONG COLUMN_DIR DIRECT /end RECORD_LAYOUT
/begin RECORD_LAYOUT Lookup1D_X_LONG AXIS_PTS_X 1 SLONG INDEX_INCR DIRECT /end RECORD_LAYOUT
/begin RECORD_LAYOUT Lookup1D_FLOAT32_IEEE FNC_VALUES 1 FLOAT32_IEEE COLUMN_DIR DIRECT /end RECORD_LAYOUT
/begin RECORD_LAYOUT Lookup1D_X_FLOAT32_IEEE AXIS_PTS_X 1 FLOAT32_IEEE INDEX_INCR DIRECT /end RECORD_LAYOUT
/begin RECORD_LAYOUT Lookup1D_FLOAT64_IEEE FNC_VALUES 1 FLOAT64_IEEE COLUMN_DIR DIRECT /end RECORD_LAYOUT
/begin RECORD_LAYOUT Lookup1D_X_FLOAT64_IEEE AXIS_PTS_X 1 FLOAT64_IEEE INDEX_INCR DIRECT /end RECORD_LAYOUT
/begin RECORD_LAYOUT Lookup2D_BOOLEAN FNC_VALUES 1 UBYTE COLUMN_DIR DIRECT /end RECORD_LAYOUT
/begin RECORD_LAYOUT Lookup2D_X_BOOLEAN AXIS_PTS_X 1 UBYTE INDEX_INCR DIRECT /end RECORD_LAYOUT
/begin RECORD_LAYOUT Lookup2D_UBYTE FNC_VALUES 1 UBYTE COLUMN_DIR DIRECT /end RECORD_LAYOUT
/begin RECORD_LAYOUT Lookup2D_X_UBYTE AXIS_PTS_X 1 UBYTE INDEX_INCR DIRECT /end RECORD_LAYOUT
/begin RECORD_LAYOUT Lookup2D_BYTE FNC_VALUES 1 SBYTE COLUMN_DIR DIRECT /end RECORD_LAYOUT
/begin RECORD_LAYOUT Lookup2D_X_BYTE AXIS_PTS_X 1 SBYTE INDEX_INCR DIRECT /end RECORD_LAYOUT
/begin RECORD_LAYOUT Lookup2D_UWORD FNC_VALUES 1 UWORD COLUMN_DIR DIRECT /end RECORD_LAYOUT
/begin RECORD_LAYOUT Lookup2D_X_UWORD AXIS_PTS_X 1 UWORD INDEX_INCR DIRECT /end RECORD_LAYOUT
/begin RECORD_LAYOUT Lookup2D_WORD FNC_VALUES 1 SWORD COLUMN_DIR DIRECT /end RECORD_LAYOUT
/begin RECORD_LAYOUT Lookup2D_X_WORD AXIS_PTS_X 1 SWORD INDEX_INCR DIRECT /end RECORD_LAYOUT
/begin RECORD_LAYOUT Lookup2D_ULONG FNC_VALUES 1 ULONG COLUMN_DIR DIRECT /end RECORD_LAYOUT
/begin RECORD_LAYOUT Lookup2D_X_ULONG AXIS_PTS_X 1 ULONG INDEX_INCR DIRECT /end RECORD_LAYOUT
/begin RECORD_LAYOUT Lookup2D_LONG FNC_VALUES 1 SLONG COLUMN_DIR DIRECT /end RECORD_LAYOUT
/begin RECORD_LAYOUT Lookup2D_X_LONG AXIS_PTS_X 1 SLONG INDEX_INCR DIRECT /end RECORD_LAYOUT
/begin RECORD_LAYOUT Lookup2D_FLOAT32_IEEE FNC_VALUES 1 FLOAT32_IEEE COLUMN_DIR DIRECT /end RECORD_LAYOUT
/begin RECORD_LAYOUT Lookup2D_X_FLOAT32_IEEE AXIS_PTS_X 1 FLOAT32_IEEE INDEX_INCR DIRECT /end RECORD_LAYOUT
/begin RECORD_LAYOUT Lookup2D_FLOAT64_IEEE FNC_VALUES 1 FLOAT64_IEEE COLUMN_DIR DIRECT /end RECORD_LAYOUT
/begin RECORD_LAYOUT Lookup2D_X_FLOAT64_IEEE AXIS_PTS_X 1 FLOAT64_IEEE INDEX_INCR DIRECT /end RECORD_LAYOUT
/begin MEASUREMENT brake_output "" FLOAT64_IEEE E55_1030_CM_double 0 0 -1.7E+308 1.7E+308 ECU_ADDRESS 0x20400750 /end MEASUREMENT
/begin MEASUREMENT acc1_input "" FLOAT64_IEEE E55_1030_CM_double 0 0 -1.7E+308 1.7E+308 ECU_ADDRESS 0x20400758 /end MEASUREMENT
/begin MEASUREMENT acc1 "" FLOAT64_IEEE E55_1030_CM_double 0 0 -1.7E+308 1.7E+308 ECU_ADDRESS 0x20400760 /end MEASUREMENT
/begin MEASUREMENT acc2_input "" FLOAT64_IEEE E55_1030_CM_double 0 0 -1.7E+308 1.7E+308 ECU_ADDRESS 0x20400768 /end MEASUREMENT
/begin MEASUREMENT acc2 "" FLOAT64_IEEE E55_1030_CM_double 0 0 -1.7E+308 1.7E+308 ECU_ADDRESS 0x20400770 /end MEASUREMENT
/begin MEASUREMENT acc "" FLOAT64_IEEE E55_1030_CM_double 0 0 -1.7E+308 1.7E+308 ECU_ADDRESS 0x20400778 /end MEASUREMENT
/begin MEASUREMENT BreakPressure_R "" FLOAT64_IEEE E55_1030_CM_double 0 0 -1.7E+308 1.7E+308 ECU_ADDRESS 0x20400780 /end MEASUREMENT
/begin MEASUREMENT MaxTempMotor_n "" FLOAT64_IEEE E55_1030_CM_double 0 0 -1.7E+308 1.7E+308 ECU_ADDRESS 0x20400788 /end MEASUREMENT
/begin MEASUREMENT Steer "" FLOAT64_IEEE E55_1030_CM_double 0 0 -1.7E+308 1.7E+308 ECU_ADDRESS 0x20400790 /end MEASUREMENT
/begin MEASUREMENT BreakPressure_F "" FLOAT64_IEEE E55_1030_CM_double 0 0 -1.7E+308 1.7E+308 ECU_ADDRESS 0x20400798 /end MEASUREMENT
/begin MEASUREMENT Yaw_Angle "" FLOAT64_IEEE E55_1030_CM_double 0 0 -1.7E+308 1.7E+308 ECU_ADDRESS 0x204007a0 /end MEASUREMENT
/begin MEASUREMENT Pitch_Angle "" FLOAT64_IEEE E55_1030_CM_double 0 0 -1.7E+308 1.7E+308 ECU_ADDRESS 0x204007a8 /end MEASUREMENT
/begin MEASUREMENT Roll_Angle "" FLOAT64_IEEE E55_1030_CM_double 0 0 -1.7E+308 1.7E+308 ECU_ADDRESS 0x204007b0 /end MEASUREMENT
/begin MEASUREMENT Yaw_Rate_d "" FLOAT64_IEEE E55_1030_CM_double 0 0 -1.7E+308 1.7E+308 ECU_ADDRESS 0x204007b8 /end MEASUREMENT
/begin MEASUREMENT velocity "" FLOAT64_IEEE E55_1030_CM_double 0 0 -1.7E+308 1.7E+308 ECU_ADDRESS 0x204007c0 /end MEASUREMENT
/begin MEASUREMENT Mz "" FLOAT64_IEEE E55_1030_CM_double 0 0 -1.7E+308 1.7E+308 ECU_ADDRESS 0x204007c8 /end MEASUREMENT
/begin MEASUREMENT Torque_FL_out "" FLOAT64_IEEE E55_1030_CM_double 0 0 -1.7E+308 1.7E+308 ECU_ADDRESS 0x204007d0 /end MEASUREMENT
/begin MEASUREMENT Torque_FR_out "" FLOAT64_IEEE E55_1030_CM_double 0 0 -1.7E+308 1.7E+308 ECU_ADDRESS 0x204007d8 /end MEASUREMENT
/begin MEASUREMENT Torque_RL_out "" FLOAT64_IEEE E55_1030_CM_double 0 0 -1.7E+308 1.7E+308 ECU_ADDRESS 0x204007e0 /end MEASUREMENT
/begin MEASUREMENT Torque_RR_out "" FLOAT64_IEEE E55_1030_CM_double 0 0 -1.7E+308 1.7E+308 ECU_ADDRESS 0x204007e8 /end MEASUREMENT
/begin MEASUREMENT delta_YawRate "" FLOAT64_IEEE E55_1030_CM_double 0 0 -1.7E+308 1.7E+308 ECU_ADDRESS 0x204007f0 /end MEASUREMENT
/begin MEASUREMENT East_Speed "" FLOAT64_IEEE E55_1030_CM_double 0 0 -1.7E+308 1.7E+308 ECU_ADDRESS 0x204007f8 /end MEASUREMENT
/begin MEASUREMENT North_Speed "" FLOAT64_IEEE E55_1030_CM_double 0 0 -1.7E+308 1.7E+308 ECU_ADDRESS 0x20400800 /end MEASUREMENT
/begin MEASUREMENT INS_IMUAccrnX "" FLOAT64_IEEE E55_1030_CM_double 0 0 -1.7E+308 1.7E+308 ECU_ADDRESS 0x20400808 /end MEASUREMENT
/begin MEASUREMENT INS_IMUAccrnY "" FLOAT64_IEEE E55_1030_CM_double 0 0 -1.7E+308 1.7E+308 ECU_ADDRESS 0x20400810 /end MEASUREMENT
/begin MEASUREMENT Yaw_Rate "" FLOAT64_IEEE E55_1030_CM_double 0 0 -1.7E+308 1.7E+308 ECU_ADDRESS 0x20400818 /end MEASUREMENT
/begin MEASUREMENT NegTorque "" FLOAT64_IEEE E55_1030_CM_double 0 0 -1.7E+308 1.7E+308 ECU_ADDRESS 0x20400820 /end MEASUREMENT
/begin MEASUREMENT INS_IMUAccrnZ "" FLOAT64_IEEE E55_1030_CM_double 0 0 -1.7E+308 1.7E+308 ECU_ADDRESS 0x20400828 /end MEASUREMENT
/begin MEASUREMENT INS_IMUAglRateX "" FLOAT64_IEEE E55_1030_CM_double 0 0 -1.7E+308 1.7E+308 ECU_ADDRESS 0x20400830 /end MEASUREMENT
/begin MEASUREMENT INS_IMUAglRateY "" FLOAT64_IEEE E55_1030_CM_double 0 0 -1.7E+308 1.7E+308 ECU_ADDRESS 0x20400838 /end MEASUREMENT
/begin MEASUREMENT Torque_RR "" FLOAT64_IEEE E55_1030_CM_double 0 0 -1.7E+308 1.7E+308 ECU_ADDRESS 0x20400840 /end MEASUREMENT
/begin MEASUREMENT Torque_RL "" FLOAT64_IEEE E55_1030_CM_double 0 0 -1.7E+308 1.7E+308 ECU_ADDRESS 0x20400848 /end MEASUREMENT
/begin MEASUREMENT Torque_FL "" FLOAT64_IEEE E55_1030_CM_double 0 0 -1.7E+308 1.7E+308 ECU_ADDRESS 0x20400850 /end MEASUREMENT
/begin MEASUREMENT Torque_FR "" FLOAT64_IEEE E55_1030_CM_double 0 0 -1.7E+308 1.7E+308 ECU_ADDRESS 0x20400858 /end MEASUREMENT
/begin MEASUREMENT To_Ground_Speed "" FLOAT64_IEEE E55_1030_CM_double 0 0 -1.7E+308 1.7E+308 ECU_ADDRESS 0x20400860 /end MEASUREMENT
/begin MEASUREMENT MaxTempIGBT_n "" FLOAT64_IEEE E55_1030_CM_double 0 0 -1.7E+308 1.7E+308 ECU_ADDRESS 0x20400868 /end MEASUREMENT
/begin MEASUREMENT MaxTempInverter_n "" FLOAT64_IEEE E55_1030_CM_double 0 0 -1.7E+308 1.7E+308 ECU_ADDRESS 0x20400870 /end MEASUREMENT
/begin MEASUREMENT DeratingRatio "" FLOAT64_IEEE E55_1030_CM_double 0 0 -1.7E+308 1.7E+308 ECU_ADDRESS 0x20400878 /end MEASUREMENT
/begin MEASUREMENT Side_Slip_Angle_d "" FLOAT64_IEEE E55_1030_CM_double 0 0 -1.7E+308 1.7E+308 ECU_ADDRESS 0x20400880 /end MEASUREMENT
/begin MEASUREMENT Algorithm_Enable "" FLOAT64_IEEE E55_1030_CM_double 0 0 -1.7E+308 1.7E+308 ECU_ADDRESS 0x20400888 /end MEASUREMENT
/begin MEASUREMENT run_flag "" FLOAT64_IEEE E55_1030_CM_double 0 0 -1.7E+308 1.7E+308 ECU_ADDRESS 0x20400890 /end MEASUREMENT
/begin MEASUREMENT TargetVelocity "" FLOAT64_IEEE E55_1030_CM_double 0 0 -1.7E+308 1.7E+308 ECU_ADDRESS 0x20400898 /end MEASUREMENT
/begin MEASUREMENT Side_Slip_Angle "" FLOAT64_IEEE E55_1030_CM_double 0 0 -1.7E+308 1.7E+308 ECU_ADDRESS 0x204008a0 /end MEASUREMENT
/begin MEASUREMENT brake_input "" FLOAT64_IEEE E55_1030_CM_double 0 0 -1.7E+308 1.7E+308 ECU_ADDRESS 0x204008a8 /end MEASUREMENT
/begin MEASUREMENT Heading_Angle "" FLOAT64_IEEE E55_1030_CM_double 0 0 -1.7E+308 1.7E+308 ECU_ADDRESS 0x204008b0 /end MEASUREMENT
/begin MEASUREMENT IVT_MsgCount "" FLOAT64_IEEE E55_1030_CM_double 0 0 -1.7E+308 1.7E+308 ECU_ADDRESS 0x204008b8 /end MEASUREMENT
/begin MEASUREMENT Power "" FLOAT64_IEEE E55_1030_CM_double 0 0 -1.7E+308 1.7E+308 ECU_ADDRESS 0x204008c0 /end MEASUREMENT
/begin MEASUREMENT Raw_Steer "" FLOAT64_IEEE E55_1030_CM_double 0 0 -1.7E+308 1.7E+308 ECU_ADDRESS 0x204008c8 /end MEASUREMENT
/begin MEASUREMENT K3105_Alive "" FLOAT64_IEEE E55_1030_CM_double 0 0 -1.7E+308 1.7E+308 ECU_ADDRESS 0x204008d0 /end MEASUREMENT
/begin MEASUREMENT LVBatteryVolt "" UWORD E55_1030_CM_uint16 0 0 0 65535 ECU_ADDRESS 0x204008d8 /end MEASUREMENT
/begin MEASUREMENT Steer_CANOK "" UBYTE E55_1030_CM_uint8 0 0 0 255 ECU_ADDRESS 0x204008da /end MEASUREMENT
/begin MEASUREMENT CAN_OK_GNSS "" UBYTE E55_1030_CM_uint8 0 0 0 255 ECU_ADDRESS 0x204008db /end MEASUREMENT
/begin MEASUREMENT CAN_OK_IMU "" UBYTE E55_1030_CM_uint8 0 0 0 255 ECU_ADDRESS 0x204008dc /end MEASUREMENT
/begin MEASUREMENT SC_State "" UBYTE E55_1030_CM_boolean 0 0 0 1 ECU_ADDRESS 0x204008dd /end MEASUREMENT
/begin MEASUREMENT precharge_input "" UBYTE E55_1030_CM_boolean 0 0 0 1 ECU_ADDRESS 0x204008de /end MEASUREMENT
/begin MEASUREMENT start_input "" UBYTE E55_1030_CM_boolean 0 0 0 1 ECU_ADDRESS 0x204008df /end MEASUREMENT
/begin MEASUREMENT break_transmit "" UBYTE E55_1030_CM_boolean 0 0 0 1 ECU_ADDRESS 0x204008e0 /end MEASUREMENT
/begin MEASUREMENT reset_input "" UBYTE E55_1030_CM_boolean 0 0 0 1 ECU_ADDRESS 0x204008e1 /end MEASUREMENT
/begin MEASUREMENT SC_Testpoint5 "" UBYTE E55_1030_CM_boolean 0 0 0 1 ECU_ADDRESS 0x204008e2 /end MEASUREMENT
/begin MEASUREMENT SC_Testpoint1 "" UBYTE E55_1030_CM_boolean 0 0 0 1 ECU_ADDRESS 0x204008e3 /end MEASUREMENT
/begin MEASUREMENT SC_Testpoint2 "" UBYTE E55_1030_CM_boolean 0 0 0 1 ECU_ADDRESS 0x204008e4 /end MEASUREMENT
/begin MEASUREMENT SC_Testpoint3 "" UBYTE E55_1030_CM_boolean 0 0 0 1 ECU_ADDRESS 0x204008e5 /end MEASUREMENT
/begin MEASUREMENT SC_Testpoint4 "" UBYTE E55_1030_CM_boolean 0 0 0 1 ECU_ADDRESS 0x204008e6 /end MEASUREMENT
/begin MEASUREMENT acc_flag "" UBYTE E55_1030_CM_boolean 0 0 0 1 ECU_ADDRESS 0x204008e7 /end MEASUREMENT
/begin MEASUREMENT readyLED_output "" UBYTE E55_1030_CM_boolean 0 0 0 1 ECU_ADDRESS 0x204008e8 /end MEASUREMENT
/begin COMPU_METHOD E55_1030_CM_double "Q = V" RAT_FUNC "%15.10" "" COEFFS 0 1 0 0 0 1 /end COMPU_METHOD
/begin COMPU_METHOD E55_1030_CM_uint16 "Q = V" RAT_FUNC "%5.0" "" COEFFS 0 1 0 0 0 1 /end COMPU_METHOD
/begin COMPU_METHOD E55_1030_CM_uint8 "Q = V" RAT_FUNC "%3.0" "" COEFFS 0 1 0 0 0 1 /end COMPU_METHOD
/begin COMPU_METHOD E55_1030_CM_boolean "Q = V" RAT_FUNC "%1.0" "" COEFFS 0 1 0 0 0 1 /end COMPU_METHOD
/begin GROUP E55_1030 "E55_1030" /* Root */ ROOT
 /begin SUB_GROUP Root_Function_Call_Subsystem2 Root_Initializationl_Subsystem /end SUB_GROUP
 /begin REF_MEASUREMENT K3105_Alive /end REF_MEASUREMENT
/end GROUP
/begin GROUP Root_Function_Call_Subsystem2 "E55_1030/Function-Call Subsystem2"
 /begin SUB_GROUP S1_SMC S1_Subsystem11 S1_Subsystem18 S1_Subsystem19 S1_Subsystem8 S1________________ /end SUB_GROUP
 /begin REF_MEASUREMENT Algorithm_Enable BreakPressure_F BreakPressure_R DeratingRatio East_Speed Heading_Angle INS_IMUAccrnX INS_IMUAccrnY INS_IMUAccrnZ INS_IMUAglRateX INS_IMUAglRateY MaxTempIGBT_n MaxTempInverter_n MaxTempMotor_n NegTorque North_Speed Pitch_Angle Roll_Angle SC_State SC_Testpoint1 SC_Testpoint2 SC_Testpoint3 SC_Testpoint4 SC_Testpoint5 Side_Slip_Angle Steer Steer_CANOK TargetVelocity To_Ground_Speed Torque_FL Torque_FL_out Torque_FR Torque_FR_out Torque_RL Torque_RL_out Torque_RR Torque_RR_out Yaw_Angle Yaw_Rate acc acc1 acc1_input acc2 acc2_input acc_flag brake_input brake_output break_transmit delta_YawRate precharge_input readyLED_output reset_input run_flag start_input velocity /end REF_MEASUREMENT
/end GROUP
/begin GROUP Root_Initializationl_Subsystem "E55_1030/Initializationl Subsystem" /begin REF_MEASUREMENT LVBatteryVolt /end REF_MEASUREMENT /end GROUP
/begin GROUP S1_SMC "E55_1030/Function-Call Subsystem2/SMC" /begin REF_MEASUREMENT Mz /end REF_MEASUREMENT /end GROUP
/begin GROUP S1_Subsystem11 "E55_1030/Function-Call Subsystem2/Subsystem11" /begin SUB_GROUP S101_Enabled_Subsystem /end SUB_GROUP /end GROUP
/begin GROUP S1_Subsystem18 "E55_1030/Function-Call Subsystem2/Subsystem18" /begin REF_MEASUREMENT CAN_OK_GNSS /end REF_MEASUREMENT /end GROUP
/begin GROUP S1_Subsystem19 "E55_1030/Function-Call Subsystem2/Subsystem19" /begin REF_MEASUREMENT CAN_OK_IMU /end REF_MEASUREMENT /end GROUP
/begin GROUP S1_Subsystem8 "E55_1030/Function-Call Subsystem2/Subsystem8" /begin SUB_GROUP S112_Enabled_Subsystem /end SUB_GROUP /end GROUP
/begin GROUP S1________________ "E55_1030/Function-Call Subsystem2/计算理想横摆角速度和质心侧偏角" /begin REF_MEASUREMENT Side_Slip_Angle_d Yaw_Rate_d /end REF_MEASUREMENT /end GROUP
/begin GROUP S101_Enabled_Subsystem "E55_1030/Function-Call Subsystem2/Subsystem11/Enabled Subsystem" /begin REF_MEASUREMENT Raw_Steer /end REF_MEASUREMENT /end GROUP
/begin GROUP S112_Enabled_Subsystem "E55_1030/Function-Call Subsystem2/Subsystem8/Enabled Subsystem" /begin REF_MEASUREMENT IVT_MsgCount Power /end REF_MEASUREMENT /end GROUP
/end MODULE
/end PROJECT
/* (add any file trailer comments here) */
/* EOF E55_1030.a2l */
